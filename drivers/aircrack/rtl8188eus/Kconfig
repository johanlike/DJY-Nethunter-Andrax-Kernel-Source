## drivers/aircrack/rtl8188eus/Kconfig
```kconfig
config RTL8188EU
	tristate "Realtek 8188E USB WiFi"
	depends on USB
	default m
	---help---
	  Help message of RTL8188EU
```

## drivers/aircrack/rtl8812au/Kconfig
```kconfig
config 88XXAU
	tristate "Realtek 88XXau USB WiFi"
	depends on USB
	default m
	---help---
	  Help message of 88XXau
```
